## port/package/boot/uboot-t153/files/board/dshanpi/t153/Kconfig
```kconfig
if TARGET_DSHANPI_T153_RAM || TARGET_DSHANPI_T153_SOURCE

config SYS_BOARD
	default "t153"

config SYS_VENDOR
	default "dshanpi"

config SYS_CONFIG_NAME
	default "dshanpi_t153_ram"

config T153_DDR_SIZE_MIB
	int "Physical T153 DDR4 capacity in MiB"
	depends on TARGET_DSHANPI_T153_SOURCE
	default 512
	range 512 1024
	help
	  Fixed single-rank x16 geometry. Only 512 (15 rows) and 1024
	  (16 rows) are implemented. Usable U-Boot/Linux RAM remains capped
	  at 384 MiB in both bring-up profiles. This is not a size probe.

config T153_PSCI_COLD_SMP
	bool "Experimental T153 four-core cold boot via PSCI 0.1"
	depends on TARGET_DSHANPI_T153_SOURCE && T153_DDR_SIZE_MIB = 1024
	select CPU_V7_HAS_NONSEC
	select ARCH_SUPPORT_PSCI
	select ARMV7_SET_CORTEX_SMPEN
	select HAS_ARMV7_SECURE_BASE
	help
	  Source CPU_ON backend for the four Cortex-A7 cores. The monitor
	  remains in SRAM C; no factory monitor is linked. CPU_OFF,
	  CPU_SUSPEND, hotplug and multi-core kexec are not implemented.
	  This is an opt-in bring-up profile; CPU0 default is unchanged.

endif
```

## port/package/boot/uboot-t153/files/configs/dshanpi_t153_source_1g_defconfig
```kconfig
CONFIG_ARM=y
CONFIG_TARGET_DSHANPI_T153_SOURCE=y
CONFIG_TEXT_BASE=0x4a000000
CONFIG_SYS_MALLOC_LEN=0x1000000
CONFIG_SYS_MALLOC_F_LEN=0x4000
CONFIG_NR_DRAM_BANKS=1
CONFIG_HAS_CUSTOM_SYS_INIT_SP_ADDR=y
CONFIG_CUSTOM_SYS_INIT_SP_ADDR=0x49f00000
CONFIG_DEFAULT_DEVICE_TREE="sun8i-t153-dshanpi-omnigate-uboot"
CONFIG_SYS_LOAD_ADDR=0x50000000
CONFIG_SKIP_LOWLEVEL_INIT_ONLY=y
CONFIG_SYS_ARCH_TIMER=y
CONFIG_FIT=y
CONFIG_FIT_VERBOSE=y
CONFIG_LEGACY_IMAGE_FORMAT=y
CONFIG_SUPPORT_RAW_INITRD=y
CONFIG_BOOTDELAY=3
CONFIG_USE_BOOTCOMMAND=y
CONFIG_BOOTCOMMAND="run t153boot"
CONFIG_BOARD_LATE_INIT=y
CONFIG_BOARD_EARLY_INIT_F=y
# CONFIG_DISPLAY_CPUINFO is not set
CONFIG_HUSH_PARSER=y
CONFIG_SYS_PROMPT="T153-SOURCE=> "
CONFIG_SYS_BOOTM_LEN=0x4000000
CONFIG_CMD_BOOTZ=y
CONFIG_CMD_IMI=y
CONFIG_CMD_CACHE=y
CONFIG_CMD_MMC=y
CONFIG_CMD_PART=y
CONFIG_CMD_FAT=y
CONFIG_CMD_EXT4=y
CONFIG_CMD_FS_GENERIC=y
CONFIG_CMD_HASH=y
CONFIG_CMD_TIME=y
CONFIG_CMD_LOADB=y
# CONFIG_CMD_SAVEENV is not set
# CONFIG_CMD_NET is not set
# CONFIG_NET is not set
CONFIG_OF_CONTROL=y
CONFIG_ENV_IS_NOWHERE=y
CONFIG_MMC=y
CONFIG_DM_MMC=y
# CONFIG_MMC_WRITE is not set
# CONFIG_MMC_HW_PARTITIONING is not set
CONFIG_SYS_MMC_MAX_BLK_COUNT=128
CONFIG_DM_SERIAL=y
CONFIG_SYS_NS16550=y
CONFIG_SYS_NS16550_MEM32=y
CONFIG_BAUDRATE=115200
CONFIG_OF_LIBFDT=y
CONFIG_SHA256=y
# CONFIG_EFI_LOADER is not set
# CONFIG_BOOTSTD is not set
CONFIG_SPL=y
CONFIG_SPL_TEXT_BASE=0x40060
CONFIG_SPL_MAX_SIZE=0x18000
CONFIG_SPL_SIZE_LIMIT=0x18000
CONFIG_SPL_FOOTPRINT_LIMIT=y
CONFIG_SPL_MAX_FOOTPRINT=0x18000
CONFIG_SPL_HAVE_INIT_STACK=y
CONFIG_SPL_STACK=0x66000
CONFIG_SPL_EARLY_BSS=y
CONFIG_SPL_SYS_MALLOC_F_LEN=0x4000
CONFIG_SPL_SYS_MALLOC_SIMPLE=y
CONFIG_SPL_FRAMEWORK=y
CONFIG_SPL_LIBCOMMON_SUPPORT=y
CONFIG_SPL_LIBGENERIC_SUPPORT=y
CONFIG_SPL_SERIAL=y
CONFIG_SPL_DM=y
CONFIG_SPL_DM_SERIAL=y
CONFIG_SPL_DM_MMC=y
CONFIG_SPL_OF_CONTROL=y
CONFIG_SPL_OF_REAL=y
CONFIG_SPL_OF_PLATDATA=n
CONFIG_SPL_DM_SEQ_ALIAS=y
CONFIG_SPL_MMC=y
CONFIG_SPL_MMC_WRITE=n
CONFIG_SYS_MMCSD_RAW_MODE_U_BOOT_USE_SECTOR=y
CONFIG_SYS_MMCSD_RAW_MODE_U_BOOT_SECTOR=0x100
CONFIG_SPL_LEGACY_IMAGE_FORMAT=y
CONFIG_SPL_LEGACY_IMAGE_CRC_CHECK=y
CONFIG_SPL_CRC32=y
CONFIG_SPL_SKIP_LOWLEVEL_INIT_ONLY=y
CONFIG_SPL_SYS_ICACHE_OFF=y
CONFIG_SPL_SYS_DCACHE_OFF=y
CONFIG_SPL_SYS_NO_VECTOR_TABLE=y
CONFIG_OF_BOARD_SETUP=y

# CONFIG_SPL_SHARES_INIT_SP_ADDR is not set

CONFIG_SPL_SYS_MMCSD_RAW_MODE=y

CONFIG_T153_DDR_SIZE_MIB=1024
```

## port/target/linux/sunxi/files/Documentation/devicetree/bindings/net/allwinner,sun8i-t153-dwmac.yaml
```yaml
# SPDX-License-Identifier: (GPL-2.0-only OR BSD-2-Clause)
%YAML 1.2
---
$id: http://devicetree.org/schemas/net/allwinner,sun8i-t153-dwmac.yaml#
$schema: http://devicetree.org/meta-schemas/core.yaml#

title: Allwinner T153 GMAC-211

maintainers:
  - Chen-Yu Tsai <wens@csie.org>
  - Maxime Ripard <mripard@kernel.org>

allOf:
  - $ref: snps,dwmac.yaml#

properties:
  compatible:
    const: allwinner,sun8i-t153-dwmac
  reg:
    items:
      - description: DWMAC controller registers
      - description: RGMII clock and delay configuration registers
  interrupts:
    maxItems: 1
  interrupt-names:
    const: macirq
  clocks:
    maxItems: 6
  clock-names:
    items:
      - const: stmmaceth
      - const: pclk
      - const: ptp_ref
      - const: phy
      - const: ahb-sw
      - const: mbus-sw
  resets:
    maxItems: 2
  reset-names:
    items:
      - const: stmmaceth
      - const: ahb
  allwinner,tx-delay-taps:
    $ref: /schemas/types.yaml#/definitions/uint32
    description: RGMII transmit delay-chain taps from board signal qualification.
    maximum: 31
  allwinner,rx-delay-taps:
    $ref: /schemas/types.yaml#/definitions/uint32
    description: RGMII receive delay-chain taps from board signal qualification.
    maximum: 31
  allwinner,external-rgmii-clock:
    type: boolean
    description: Select the external RGMII transmit clock source.
  allwinner,provide-phy-clock:
    type: boolean
    description: Enable the CCU clock output used as the external PHY reference.

required:
  - compatible
  - reg
  - interrupts
  - interrupt-names
  - clocks
  - clock-names
  - resets
  - reset-names
  - phy-mode
  - phy-handle

unevaluatedProperties: false
```

## port/target/linux/sunxi/files/Documentation/devicetree/bindings/net/can/allwinner,sun8i-t153-can.yaml
```yaml
# SPDX-License-Identifier: (GPL-2.0-only OR BSD-2-Clause)
%YAML 1.2
---
$id: http://devicetree.org/schemas/net/can/allwinner,sun8i-t153-can.yaml#
$schema: http://devicetree.org/meta-schemas/core.yaml#

title: Allwinner T153 CAN-FD controller

maintainers:
  - Chen-Yu Tsai <wens@csie.org>
  - Maxime Ripard <mripard@kernel.org>

allOf:
  - $ref: can-controller.yaml#

properties:
  compatible:
    const: allwinner,sun8i-t153-can
  reg:
    items:
      - description: Bosch M_CAN core registers
      - description: Private message RAM
      - description: Allwinner CAN top control registers
  reg-names:
    items:
      - const: m_can
      - const: message_ram
      - const: top
  interrupts:
    maxItems: 1
  interrupt-names:
    const: int0
  clocks:
    maxItems: 3
  clock-names:
    items:
      - const: hclk
      - const: cclk
      - const: mbus
  resets:
    maxItems: 2
  reset-names:
    items:
      - const: core
      - const: sys
  bosch,mram-cfg:
    description: |
      Message RAM configuration data.
      Multiple M_CAN instances can share the same Message RAM
      and each element(e.g Rx FIFO or Tx Buffer and etc) number
      in Message RAM is also configurable, so this property is
      telling driver how the shared or private Message RAM are
      used by this M_CAN controller.

      The format should be as follows:
      <offset sidf_elems xidf_elems rxf0_elems rxf1_elems rxb_elems txe_elems txb_elems>
      The 'offset' is an address offset of the Message RAM where
      the following elements start from. This is usually set to
      0x0 if you're using a private Message RAM. The remain cells
      are used to specify how many elements are used for each FIFO/Buffer.

      M_CAN includes the following elements according to user manual:
      11-bit Filter	0-128 elements / 0-128 words
      29-bit Filter	0-64 elements / 0-128 words
      Rx FIFO 0		0-64 elements / 0-1152 words
      Rx FIFO 1		0-64 elements / 0-1152 words
      Rx Buffers	0-64 elements / 0-1152 words
      Tx Event FIFO	0-32 elements / 0-64 words
      Tx Buffers	0-32 elements / 0-576 words

      Please refer to 2.4.1 Message RAM Configuration in Bosch
      M_CAN user manual for details.
    $ref: /schemas/types.yaml#/definitions/int32-array
    items:
      - description: The 'offset' is an address offset of the Message RAM where
          the following elements start from. This is usually set to 0x0 if
          you're using a private Message RAM.
        default: 0
      - description: 11-bit Filter 0-128 elements / 0-128 words
        minimum: 0
        maximum: 128
      - description: 29-bit Filter 0-64 elements / 0-128 words
        minimum: 0
        maximum: 64
      - description: Rx FIFO 0 0-64 elements / 0-1152 words
        minimum: 0
        maximum: 64
      - description: Rx FIFO 1 0-64 elements / 0-1152 words
        minimum: 0
        maximum: 64
      - description: Rx Buffers 0-64 elements / 0-1152 words
        minimum: 0
        maximum: 64
      - description: Tx Event FIFO 0-32 elements / 0-64 words
        minimum: 0
        maximum: 32
      - description: Tx Buffers 0-32 elements / 0-576 words
        minimum: 0
        maximum: 32
    minItems: 8


required:
  - compatible
  - reg
  - reg-names
  - interrupts
  - interrupt-names
  - clocks
  - clock-names
  - resets
  - reset-names
  - bosch,mram-cfg

unevaluatedProperties: false
```

## port/target/linux/sunxi/files/Documentation/devicetree/bindings/phy/allwinner,sun8i-t153-usb-phy.yaml
```yaml
# SPDX-License-Identifier: (GPL-2.0-only OR BSD-2-Clause)
%YAML 1.2
---
$id: http://devicetree.org/schemas/phy/allwinner,sun8i-t153-usb-phy.yaml#
$schema: http://devicetree.org/meta-schemas/core.yaml#

title: Allwinner T153 USB2 AW PHY host port

maintainers:
  - Chen-Yu Tsai <wens@csie.org>
  - Maxime Ripard <mripard@kernel.org>

properties:
  compatible:
    const: allwinner,sun8i-t153-usb-phy
  reg:
    items:
      - description: AW PHY application registers
      - description: USB2 subsystem digital application registers
      - description: Host port 1 bypass register
  reg-names:
    items:
      - const: phy
      - const: top
      - const: pmu1
  clocks:
    maxItems: 3
  clock-names:
    items:
      - const: bus
      - const: bus-cfg
      - const: ref
  resets:
    maxItems: 1
  "#phy-cells":
    const: 1
    description: Port index; the current implementation supports host port 1.

required:
  - compatible
  - reg
  - reg-names
  - clocks
  - clock-names
  - resets
  - "#phy-cells"

additionalProperties: false
```

## port/target/linux/sunxi/files/Documentation/devicetree/bindings/power/reset/allwinner,sun8i-t153-reboot-mode.yaml
```yaml
# SPDX-License-Identifier: (GPL-2.0-only OR BSD-2-Clause)
%YAML 1.2
---
$id: http://devicetree.org/schemas/power/reset/allwinner,sun8i-t153-reboot-mode.yaml#
$schema: http://devicetree.org/meta-schemas/core.yaml#

title: Allwinner T153 RTC BootROM reboot mode

maintainers:
  - Chen-Yu Tsai <wens@csie.org>
  - Maxime Ripard <mripard@kernel.org>

description: |
  RTC data word 2 requests BootROM USB FEL mode. Only this four-byte
  scratch register is owned by the reboot-mode driver; the RTC calendar
  and the separate data word 6 boot-mode flag are unaffected. A watchdog
  driver supplies the subsequent system reset.

allOf:
  - $ref: reboot-mode.yaml#

properties:
  compatible:
    const: allwinner,sun8i-t153-reboot-mode
  reg:
    maxItems: 1
  mode-normal:
    const: 0
  mode-efex:
    const: 0x5aa5a55a

required:
  - compatible
  - reg
  - mode-normal
  - mode-efex

unevaluatedProperties: false

examples:
  - |
    reboot-mode@7090108 {
        compatible = "allwinner,sun8i-t153-reboot-mode";
        reg = <0x07090108 0x4>;
        mode-normal = <0>;
        mode-efex = <0x5aa5a55a>;
    };
```

## port/uboot/files/board/dshanpi/t153/Kconfig
```kconfig
if TARGET_DSHANPI_T153_RAM || TARGET_DSHANPI_T153_SOURCE

config SYS_BOARD
	default "t153"

config SYS_VENDOR
	default "dshanpi"

config SYS_CONFIG_NAME
	default "dshanpi_t153_ram"

config T153_DDR_SIZE_MIB
	int "Physical T153 DDR4 capacity in MiB"
	depends on TARGET_DSHANPI_T153_SOURCE
	default 512
	range 512 1024
	help
	  Fixed single-rank x16 geometry. Only 512 (15 rows) and 1024
	  (16 rows) are implemented. Usable U-Boot/Linux RAM remains capped
	  at 384 MiB in both bring-up profiles. This is not a size probe.

endif
```

## port/uboot/files/configs/dshanpi_t153_ram_defconfig
```kconfig
CONFIG_ARM=y
CONFIG_TARGET_DSHANPI_T153_RAM=y
CONFIG_TEXT_BASE=0x4a000000
CONFIG_SYS_MALLOC_LEN=0x1000000
CONFIG_SYS_MALLOC_F_LEN=0x4000
CONFIG_NR_DRAM_BANKS=1
CONFIG_HAS_CUSTOM_SYS_INIT_SP_ADDR=y
CONFIG_CUSTOM_SYS_INIT_SP_ADDR=0x49f00000
CONFIG_DEFAULT_DEVICE_TREE="sun8i-t153-dshanpi-omnigate-uboot"
CONFIG_SYS_LOAD_ADDR=0x50000000
CONFIG_SKIP_LOWLEVEL_INIT_ONLY=y
CONFIG_SYS_ARCH_TIMER=y
CONFIG_FIT=y
CONFIG_FIT_VERBOSE=y
CONFIG_LEGACY_IMAGE_FORMAT=y
CONFIG_SUPPORT_RAW_INITRD=y
CONFIG_BOOTDELAY=-1
# CONFIG_USE_BOOTCOMMAND is not set
CONFIG_BOARD_EARLY_INIT_F=y
# CONFIG_DISPLAY_CPUINFO is not set
CONFIG_HUSH_PARSER=y
CONFIG_SYS_PROMPT="T153-RAM=> "
CONFIG_SYS_BOOTM_LEN=0x4000000
CONFIG_CMD_BOOTZ=y
CONFIG_CMD_IMI=y
CONFIG_CMD_CACHE=y
CONFIG_CMD_MMC=y
CONFIG_CMD_PART=y
CONFIG_CMD_FAT=y
CONFIG_CMD_EXT4=y
CONFIG_CMD_FS_GENERIC=y
CONFIG_CMD_HASH=y
CONFIG_CMD_TIME=y
CONFIG_CMD_LOADB=y
# CONFIG_CMD_SAVEENV is not set
# CONFIG_CMD_NET is not set
# CONFIG_NET is not set
CONFIG_OF_CONTROL=y
CONFIG_ENV_IS_NOWHERE=y
CONFIG_MMC=y
CONFIG_DM_MMC=y
# CONFIG_MMC_WRITE is not set
# CONFIG_MMC_HW_PARTITIONING is not set
CONFIG_SYS_MMC_MAX_BLK_COUNT=128
CONFIG_DM_SERIAL=y
CONFIG_SYS_NS16550=y
CONFIG_SYS_NS16550_MEM32=y
CONFIG_BAUDRATE=115200
CONFIG_OF_LIBFDT=y
CONFIG_SHA256=y
# CONFIG_EFI_LOADER is not set
# CONFIG_BOOTSTD is not set
```
